&soc {
	eud: qcom,msm-eud@88e0000 {
		compatible = "qcom,msm-eud";
		interrupt-names = "eud_irq";
		interrupt-parent = <&pdc>;
		interrupts = <11 IRQ_TYPE_LEVEL_HIGH>;
		reg = <0 0x088E0000 0 0x2000>,
			<0 0x088E2000 0 0x1000>;
		reg-names = "eud_base", "eud_mode_mgr2";
	};
};
